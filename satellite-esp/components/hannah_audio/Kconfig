## satellite-esp/components/hannah_led/Kconfig
```kconfig
menu "Hannah LED"

    config HANNAH_LED_GPIO
        int "SK6812 / WS2812B Data GPIO"
        default 5
        help
            GPIO für den SK6812MINI-E-Ring (RMT-Peripheral).
            PCB Rev.3: GPIO5 → SN74AHCT125 Level-Shifter → LED-Ring.
            DevKitC-1 Breadboard: GPIO48.

    config HANNAH_LED_COUNT
        int "Anzahl LEDs im Ring"
        default 12
        range 1 64

    config HANNAH_LED_BRIGHTNESS_DEFAULT
        int "Standard-Helligkeit des LED-Rings in Prozent"
        default 100
        range 0 100
        help
            Gilt, solange noch keine Helligkeit per MQTT
            (hannah/satellite/<device>/led_brightness/set) eingestellt wurde.
            100 = die festen Helligkeitswerte der Animationen, unverändert.

    config HANNAH_STATUS_LED_ENABLED
        bool "Status-LED aktivieren"
        default y
        help
            Einfache GPIO-LED die leuchtet wenn der ESP läuft.

    config HANNAH_STATUS_LED_GPIO
        int "Status-LED GPIO"
        default 18
        depends on HANNAH_STATUS_LED_ENABLED
        help
            PCB Rev.4: GPIO18.

endmenu
```

## satellite-esp/components/hannah_sendspin/Kconfig
```kconfig
menu "Hannah Sendspin"

    config HANNAH_SENDSPIN_ENABLED
        bool "Sendspin-Player (Musik von Music Assistant)"
        default y
        depends on HANNAH_SPEAKER_ENABLED
        help
            Der Satellit meldet sich per mDNS (_sendspin._tcp) als Sendspin-Player und
            spielt Musik von Music Assistant ab (ab MA 2.11.0). Braucht
            CONFIG_HANNAH_SPK_SAMPLE_RATE=48000 (TTS wird dann ×3 hochgerechnet), die
            zugehörigen Einstellungen stehen in sdkconfig.defaults (Refs #440).

    config HANNAH_SENDSPIN_MIN_INTERNAL_FREE
        int "Sendspin startet nur, wenn beim Start mindestens so viele Byte internes RAM frei sind (0 = immer)"
        default 57344
        depends on HANNAH_SENDSPIN_ENABLED
        help
            Der Sendspin-Client braucht internes RAM für seine Threads und Sockets, danach
            kommen WLAN, MQTT und TLS dazu. Ist beim Start zu wenig frei, scheiterten
            mDNS, Thread-Anlage und andere Tasks, der Satellit stürzte ab oder startete
            vom Heap-Watchdog neu (Rev5, Refs #463). Mit dieser Schwelle bleibt Sendspin
            dann aus (Logzeile mit dem freien Heap) und der Rest läuft weiter. Der Wert
            ist die Summe aus Heap-Watchdog-Schwelle (20 KB), dem Verbrauch des Clients
            und dem Bedarf der Tasks, die nach dem Start noch anlaufen, und ist geschätzt.

    config HANNAH_SENDSPIN_GIVE_UP_S
        int "Sendspin gibt auf, wenn nach N Sekunden kein Music Assistant verbunden war (0 = nie)"
        default 600
        depends on HANNAH_SENDSPIN_ENABLED
        help
            Findet der Satellit nach dem Start so lange keinen Music Assistant, wird der
            Client gestoppt und mDNS freigegeben. Nur zur Laufzeit: ein Neustart startet
            den Client wieder. Gilt nicht, wenn schon einmal eine Verbindung bestand.
            Ist CONFIG_HANNAH_SENDSPIN_RETRY_PAUSE_S gesetzt, sucht der Satellit nach der
            Pause erneut, jeweils für diese Dauer.

    config HANNAH_SENDSPIN_RETRY_PAUSE_S
        int "Sendspin sucht nach so vielen Sekunden Pause erneut nach Music Assistant (0 = nie)"
        default 1800
        depends on HANNAH_SENDSPIN_ENABLED && HANNAH_SENDSPIN_GIVE_UP_S > 0
        help
            Music Assistant braucht nach einem Neustart eines Satelliten oft länger als die
            Frist HANNAH_SENDSPIN_GIVE_UP_S, um ihn zu verbinden. Damit der Satellit danach
            nicht bis zum nächsten Neustart fehlt, wird der Client nach dieser Pause wieder
            gestartet (mDNS an) und sucht erneut GIVE_UP_S Sekunden lang; ohne Treffer pausiert
            er wieder. Sobald einmal eine Verbindung bestand, läuft der Client durchgehend
            (Refs #450).

    config HANNAH_SENDSPIN_WIFI_PS_NONE
        bool "WLAN-Power-Save abschalten, solange ein Sendspin-Stream läuft"
        default y
        depends on HANNAH_SENDSPIN_ENABLED
        help
            Im Modem-Sleep (ESP-IDF-Standard) schläft der Satellit zwischen den Beacons und der
            Access Point puffert die Pakete bis zum nächsten Beacon (rund 100 ms). Das erzeugt
            Jitter, den der Sync-Task als "Lost sync" meldet, und hörbare Aussetzer in
            Sync-Gruppen. Mit dieser Option bleibt das Funkmodul während des Streams wach und
            fällt danach (Stream-Ende, Verbindungsverlust) auf den vorherigen Modus zurück.
            Kostet nur im Stream etwas mehr Strom (Refs #448).

    config HANNAH_SENDSPIN_STATS_PERIOD_S
        int "Sendspin-Statistik ins Log alle N Sekunden (0 = aus)"
        default 10
        depends on HANNAH_SENDSPIN_ENABLED
        help
            Verbunden, Zeitsync, Sync-Fehler, freier Heap (intern und PSRAM) — als
            Grundlage für die Messung von Heap und Last mit aktivem Wakeword.

    config HANNAH_SENDSPIN_DIAG_PERIOD_S
        int "Sendspin-Verbindungsdiagnose ins Log alle N Sekunden, solange keine Verbindung besteht (0 = aus)"
        default 60
        depends on HANNAH_SENDSPIN_ENABLED
        help
            Solange der Satellit nicht mit Music Assistant verbunden ist, loggt er in diesem
            Takt, ob er Music Assistant per mDNS sieht (_sendspin-server._tcp), wie viele
            andere Sendspin-Geräte er sieht und wie viele TCP-Verbindungen auf dem
            Sendspin-Port gerade anstehen, bestehen oder gerade beendet wurden. Damit ist
            erkennbar, ob Music Assistant überhaupt anklopft (Refs #457).

endmenu
```

## satellite-esp/components/hannah_wakeword/Kconfig
```kconfig
menu "Hannah Wake Word"

    config HANNAH_WAKEWORD_ENABLED
        bool "Wake-Word-Erkennung aktivieren"
        default y
        help
            Aktiviert die lokale Wake-Word-Erkennung (microWakeWord, TFLite Micro).
            Wenn deaktiviert: PTT-Modus (Taster halten zum Sprechen).

    config HANNAH_WAKEWORD_THRESHOLD
        int "Erkennungsschwelle (0–100)"
        default 75
        range 0 100
        depends on HANNAH_WAKEWORD_ENABLED
        help
            Confidence-Schwelle für die Wake-Word-Erkennung (Prozent).
            75 (~0.75) ist ein guter Startwert.

    config HANNAH_VAD_SILENCE_MS
        int "Stille-Timeout nach Erkennung (ms)"
        default 1500
        range 500 5000
        help
            Wie lange Stille anhält bis audio_end gesendet wird.

    config HANNAH_VAD_WEBRTC_AGGRESSIVENESS
        int "WebRTC VAD Aggressivität (0–3)"
        default 2
        range 0 3
        help
            Aggressivität der WebRTC-VAD-Stille-Erkennung.
            0 = sensitiv (weniger Nicht-Sprache herausgefiltert),
            3 = aggressiv (Musik und Hintergrundgeräusche zuverlässig als Stille erkannt).

    config HANNAH_TFLITE_ARENA_KB
        int "TFLite-Micro Arena-Größe (KB)"
        default 128
        range 64 4096
        help
            Arbeitsspeicher für den TFLite-Micro-Interpreter.
            Bei AllocateTensors-Fehler erhöhen — arena_used_bytes() im Log
            (Erfolgs- oder Fehlerfall) zeigt den tatsächlichen Bedarf.
            Modellabhängig, nicht nur von der reinen Dateigröße: ein
            hey_hannah-Retrain (90 Ops, CNN-Streaming) brauchte real nur
            29332 B; ein anderer Retrain mit anderer Architektur (LayerNorm-
            artig statt CNN) scheiterte dagegen komplett am Kernel, nicht an
            der Arena-Größe (#171/#172).

endmenu
```
